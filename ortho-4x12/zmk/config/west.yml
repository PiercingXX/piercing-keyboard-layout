## ortho-4x12/zmk/config/west.yml
```yaml
manifest:
  remotes:
    - name: petejohanson
      url-base: https://github.com/petejohanson
    - name: zmkfirmware
      url-base: https://github.com/zmkfirmware
  projects:
    - name: zmk
      remote: zmkfirmware
      revision: v0.3
      import: app/west.yml
    - name: blank-slate-zmk-module
      remote: petejohanson
      revision: v0.3
  self:
    # "config", not this directory's repo-relative path: the build workflow
    # stages these files at <workspace>/config before running west, because
    # west requires the manifest directory to sit directly under the
    # workspace root. See .github/workflows/zmk-blank-slate.yml.
    path: config
```
